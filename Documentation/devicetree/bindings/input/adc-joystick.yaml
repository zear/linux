## Documentation/devicetree/bindings/input/adc-joystick.yaml
```yaml
# SPDX-License-Identifier: (GPL-2.0 OR BSD-2-Clause)
# Copyright 2019-2020 Artur Rojek
%YAML 1.2
---
$id: "http://devicetree.org/schemas/bindings/input/adc-joystick.yaml#"
$schema: "http://devicetree.org/meta-schemas/core.yaml#"

title: ADC attached joystick

maintainers:
  - Artur Rojek <contact@artur-rojek.eu>

description: |
  Bindings for joystick devices connected to ADC controllers supporting
  the Industrial I/O subsystem.

properties:
  compatible:
    const: adc-joystick

  io-channels:
    description: |
      List of phandle and IIO specifier pairs.
      Each pair defines one ADC channel to which a joystick axis is connected.
      See Documentation/devicetree/bindings/iio/iio-bindings.txt for details.

required:
  - compatible
  - io-channels

additionalProperties: false

patternProperties:
  "^axis@([0-9])$":
    type: object
    description: |
      Represents a joystick axis bound to the given ADC channel.
      For each entry in the io-channels list, one axis subnode with a matching
      index must be specified.

    properties:
      linux,abs-code:
        $ref: /schemas/types.yaml#/definitions/uint32
        description: EV_ABS specific event code generated by the axis.

      linux,abs-range:
        $ref: /schemas/types.yaml#/definitions/uint32-array
        items:
          - description: minimum value
          - description: maximum value
        description: |
          Minimum and maximum values produced by the axis.
          For an ABS_X axis this will be the left-most and right-most
          inclination of the joystick. If min > max, it is left to userspace to
          treat the axis as inverted.
          This property is interpreted as two signed 32 bit values.

      linux,abs-fuzz:
        $ref: /schemas/types.yaml#/definitions/uint32
        description: |
          Amount of noise in the input value.
          Omitting this property indicates the axis is precise.

      linux,abs-flat:
        $ref: /schemas/types.yaml#/definitions/uint32
        description: |
          Axial "deadzone", or area around the center position, where the axis
          is considered to be at rest.
          Omitting this property indicates the axis always returns to exactly
          the center position.

    required:
      - linux,abs-code
      - linux,abs-range

    additionalProperties: false

examples:
  - |
    #include <dt-bindings/iio/adc/ingenic,adc.h>
    #include <dt-bindings/input/input.h>

    joystick: adc-joystick {
      compatible = "adc-joystick";
      io-channels = <&adc INGENIC_ADC_TOUCH_XP>,
                    <&adc INGENIC_ADC_TOUCH_YP>;

      axis@0 {
              linux,abs-code = <ABS_X>;
              linux,abs-range = <3300 0>;
              linux,abs-fuzz = <4>;
              linux,abs-flat = <200>;
      };
      axis@1 {
              linux,abs-code = <ABS_Y>;
              linux,abs-range = <0 3300>;
              linux,abs-fuzz = <4>;
              linux,abs-flat = <200>;
      };
    };
```

## Documentation/devicetree/bindings/remoteproc/ingenic,vpu.txt
```
* Ingenic JZ47xx auxiliary processor

Inside the Video Processing Unit (VPU) of the recent JZ47xx SoCs from Ingenic
is a second Xburst MIPS CPU very similar to the main core.
This document describes the devicetree bindings for this auxiliary processor.

Required properties:
- compatible: Should be "ingenic,jz4770-vpu-rproc"
- reg: Must contain the registers location and length for:
  * the auxiliary processor,
  * the Tightly Coupled Shared Memory 0 (TCSM0),
  * the Tightly Coupled Shared Memory 1 (TCSM1),
  * the shared SRAM.
- reg-names: Must contain "aux", "tcsm0", "tcsm1", "sram".
- clocks: Clock specifier for the AUX and VPU clocks.
- clock-names: Must contain "aux", "vpu".
- interrupts: Interrupt specifier for the VPU hardware block.

Example:

vpu: cpu@132a0000 {
	compatible = "ingenic,jz4770-vpu-rproc";

	reg = <0x132a0000 0x20 /* AUX */
		   0xf4000000 0x4000 /* TCSM0 */
		   0x132c0000 0xc000 /* TCSM1 */
		   0x132f0000 0x7000 /* SRAM */
	>;
	reg-names = "aux", "tcsm0", "tcsm1", "sram";

	clocks = <&cgu JZ4770_CLK_AUX>, <&cgu JZ4770_CLK_VPU>;
	clock-names = "aux", "vpu";

	interrupt-parent = <&cpuintc>;
	interrupts = <3>;
};
```

## Documentation/devicetree/bindings/usb/ingenic,jz4770-phy.txt
```
Ingenic JZ4770 USB PHY

Required properties:
- compatible: Must be "ingenic,jz4770-phy"
- #phy-cells: Must be 0
- clocks: phandle to the PHY clock.
  See Documentation/devicetree/bindings/clock/clock-bindings.txt
- clock-names: Should be "phy"

Optional properties:
- extcon : external connector for idpin change detection, needed
           when using dual-role mode.

Example:

otg_extcon: extcon {
	compatible = "linux,extcon-usb-gpio";
	id-gpio = <&gpf 18 GPIO_ACTIVE_HIGH>;
};

otg_phy: usb-phy@1000003c {
	compatible = "ingenic,jz4770-phy";
	reg = <0x1000003c 0x10>;

	clocks = <&cgu JZ4770_CLK_OTG_PHY>;
	clock-names = "otg_phy";

	#phy-cells = <0>;

	extcon = <&otg_extcon>;
};
```

## arch/mips/configs/rs90_defconfig
```kconfig
# CONFIG_LOCALVERSION_AUTO is not set
CONFIG_SYSVIPC=y
# CONFIG_CROSS_MEMORY_ATTACH is not set
CONFIG_PREEMPT=y
CONFIG_LOG_BUF_SHIFT=14
# CONFIG_COMPAT_BRK is not set
CONFIG_SLAB=y
CONFIG_MACH_INGENIC=y
CONFIG_JZ4740_RS90=y
CONFIG_HZ_100=y
# CONFIG_SECCOMP is not set
# CONFIG_SUSPEND is not set
# CONFIG_BLK_DEV_BSG is not set
CONFIG_PARTITION_ADVANCED=y
# CONFIG_EFI_PARTITION is not set
# CONFIG_IOSCHED_CFQ is not set
# CONFIG_CORE_DUMP_DEFAULT_ELF_HEADERS is not set
# CONFIG_COMPACTION is not set
CONFIG_NET=y
CONFIG_PACKET=y
CONFIG_UNIX=y
CONFIG_INET=y
CONFIG_IP_MULTICAST=y
CONFIG_IP_ADVANCED_ROUTER=y
CONFIG_IP_MULTIPLE_TABLES=y
CONFIG_IP_ROUTE_MULTIPATH=y
CONFIG_IP_ROUTE_VERBOSE=y
CONFIG_IP_MROUTE=y
CONFIG_IP_MROUTE_MULTIPLE_TABLES=y
# CONFIG_INET_XFRM_MODE_TRANSPORT is not set
# CONFIG_INET_XFRM_MODE_TUNNEL is not set
# CONFIG_INET_XFRM_MODE_BEET is not set
# CONFIG_INET_DIAG is not set
CONFIG_TCP_CONG_ADVANCED=y
# CONFIG_TCP_CONG_BIC is not set
# CONFIG_TCP_CONG_CUBIC is not set
# CONFIG_TCP_CONG_HTCP is not set
# CONFIG_IPV6 is not set
CONFIG_UEVENT_HELPER_PATH="/sbin/hotplug"
CONFIG_DEVTMPFS=y
CONFIG_DEVTMPFS_MOUNT=y
CONFIG_MTD=y
CONFIG_CC_FTL=y
CONFIG_MTD_NAND=y
CONFIG_MTD_NAND_JZ4780=y
CONFIG_BLK_DEV_LOOP=y
CONFIG_BLK_DEV_LOOP_MIN_COUNT=0
CONFIG_NETDEVICES=y
# CONFIG_ETHERNET is not set
# CONFIG_WLAN is not set
CONFIG_INPUT_EVDEV=y
# CONFIG_KEYBOARD_ATKBD is not set
CONFIG_KEYBOARD_GPIO=y
# CONFIG_INPUT_MOUSE is not set
# CONFIG_SERIO is not set
CONFIG_LEGACY_PTY_COUNT=2
CONFIG_SERIAL_8250=y
CONFIG_SERIAL_8250_CONSOLE=y
CONFIG_SERIAL_8250_NR_UARTS=2
CONFIG_SERIAL_8250_RUNTIME_UARTS=2
CONFIG_SERIAL_8250_INGENIC=y
# CONFIG_HW_RANDOM is not set
CONFIG_POWER_SUPPLY=y
CONFIG_CHARGER_GPIO=y
# CONFIG_HWMON is not set
CONFIG_WATCHDOG=y
CONFIG_JZ4740_WDT=y
CONFIG_REGULATOR=y
CONFIG_REGULATOR_FIXED_VOLTAGE=y
CONFIG_FB=y
# CONFIG_VGA_CONSOLE is not set
CONFIG_FRAMEBUFFER_CONSOLE=y
# CONFIG_HID_A4TECH is not set
# CONFIG_HID_APPLE is not set
# CONFIG_HID_BELKIN is not set
# CONFIG_HID_CHERRY is not set
# CONFIG_HID_CHICONY is not set
# CONFIG_HID_CYPRESS is not set
# CONFIG_HID_EZKEY is not set
# CONFIG_HID_ITE is not set
# CONFIG_HID_KENSINGTON is not set
# CONFIG_HID_LOGITECH is not set
# CONFIG_HID_MICROSOFT is not set
# CONFIG_HID_MONTEREY is not set
CONFIG_USB_MUSB_HDRC=y
CONFIG_USB_MUSB_JZ4740=y
CONFIG_MUSB_PIO_ONLY=y
CONFIG_NOP_USB_XCEIV=y
CONFIG_USB_GADGET=y
CONFIG_USB_ETH=y
CONFIG_MMC=y
# CONFIG_PWRSEQ_EMMC is not set
CONFIG_MMC_JZ4740=y
CONFIG_RTC_CLASS=y
# CONFIG_RTC_NVMEM is not set
CONFIG_RTC_DRV_JZ4740=y
CONFIG_DMADEVICES=y
CONFIG_DMA_JZ4780=y
# CONFIG_VIRTIO_MENU is not set
# CONFIG_MIPS_PLATFORM_DEVICES is not set
CONFIG_INGENIC_OST=y
# CONFIG_IOMMU_SUPPORT is not set
CONFIG_MEMORY=y
CONFIG_PWM=y
CONFIG_PWM_JZ4740=y
CONFIG_EXT4_FS=y
# CONFIG_DNOTIFY is not set
CONFIG_VFAT_FS=y
CONFIG_PROC_KCORE=y
CONFIG_TMPFS=y
CONFIG_SQUASHFS=y
# CONFIG_NETWORK_FILESYSTEMS is not set
CONFIG_NLS_CODEPAGE_437=y
CONFIG_NLS_CODEPAGE_737=y
CONFIG_NLS_CODEPAGE_775=y
CONFIG_NLS_CODEPAGE_850=y
CONFIG_NLS_CODEPAGE_852=y
CONFIG_NLS_CODEPAGE_855=y
CONFIG_NLS_CODEPAGE_857=y
CONFIG_NLS_CODEPAGE_860=y
CONFIG_NLS_CODEPAGE_861=y
CONFIG_NLS_CODEPAGE_862=y
CONFIG_NLS_CODEPAGE_863=y
CONFIG_NLS_CODEPAGE_864=y
CONFIG_NLS_CODEPAGE_865=y
CONFIG_NLS_CODEPAGE_866=y
CONFIG_NLS_CODEPAGE_869=y
CONFIG_NLS_CODEPAGE_936=y
CONFIG_NLS_CODEPAGE_950=y
CONFIG_NLS_CODEPAGE_932=y
CONFIG_NLS_CODEPAGE_949=y
CONFIG_NLS_CODEPAGE_874=y
CONFIG_NLS_ISO8859_8=y
CONFIG_NLS_CODEPAGE_1250=y
CONFIG_NLS_CODEPAGE_1251=y
CONFIG_NLS_ASCII=y
CONFIG_NLS_ISO8859_1=y
CONFIG_NLS_ISO8859_2=y
CONFIG_NLS_ISO8859_3=y
CONFIG_NLS_ISO8859_4=y
CONFIG_NLS_ISO8859_5=y
CONFIG_NLS_ISO8859_6=y
CONFIG_NLS_ISO8859_7=y
CONFIG_NLS_ISO8859_9=y
CONFIG_NLS_ISO8859_13=y
CONFIG_NLS_ISO8859_14=y
CONFIG_NLS_ISO8859_15=y
CONFIG_NLS_KOI8_R=y
CONFIG_NLS_KOI8_U=y
CONFIG_NLS_UTF8=y
CONFIG_CRYPTO_DEFLATE=y
CONFIG_CRYPTO_LZO=y
CONFIG_FONTS=y
CONFIG_FONT_SUN8x16=y
CONFIG_PRINTK_TIME=y
CONFIG_STRIP_ASM_SYMS=y
CONFIG_DEBUG_FS=y
CONFIG_PANIC_ON_OOPS=y
CONFIG_STACKTRACE=y
# CONFIG_RUNTIME_TESTING_MENU is not set
CONFIG_CMDLINE_BOOL=y
CONFIG_CMDLINE="mem=0x0020M console=ttyS0,57600 earlycon console=tty0 root=/dev/mmcblk0p1 rootfstype=vfat ro rootwait init=/mininit-syspart"
CONFIG_CMDLINE_OVERRIDE=y
```
